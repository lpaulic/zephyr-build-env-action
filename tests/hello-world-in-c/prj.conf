## CMakeLists.txt
```
cmake_minimum_required(VERSION 3.20.0)

find_package(Zephyr REQUIRED HINTS $ENV{ZEPHYR_BASE})
project(hello_world)

target_sources(app PRIVATE src/main.c)
# TODO: add google test framework
```

## prj.conf
```kconfig
# Nothing is defined
```

## src/main.c
```c
#include <stdio.h>

int main(void) {
  printf("Hello World from Zephyr C app!\n");
  return 0;
}
```
